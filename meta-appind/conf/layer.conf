## meta-appind/conf/layer.conf
```bitbake
# We have a conf and classes directory, add to BBPATH
BBPATH .= ":${LAYERDIR}"

# We have recipes-* directories, add to BBFILES
BBFILES += "${LAYERDIR}/recipes-*/*/*.bb \
            ${LAYERDIR}/recipes-*/*/*.bbappend"

BBFILE_COLLECTIONS += "meta-appind"
BBFILE_PATTERN_meta-appind = "^${LAYERDIR}/"
BBFILE_PRIORITY_meta-appind = "6"

LAYERDEPENDS_meta-appind = "core"
LAYERSERIES_COMPAT_meta-appind = "scarthgap"
```
